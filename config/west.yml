## config/west.yml
```yaml
manifest:
  remotes:
    - name: SplittedSpace
      url-base: https://github.com/SplittedSpace
  projects:
    - name: zmk-firmware
      remote: SplittedSpace
      revision: v0.3
      import: app/west.yml
  self:
    path: config
```
